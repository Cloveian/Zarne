## boards/shields/zarne/Kconfig.shield
```kconfig
# Copyright (c) 2020 Pete Johanson
# SPDX-License-Identifier: MIT

config SHIELD_ZARNE_LEFT
    def_bool $(shields_list_contains,zarne_left)

config SHIELD_ZARNE_RIGHT
    def_bool $(shields_list_contains,zarne_right)
```
